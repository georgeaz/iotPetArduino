// ************************************* Oled pictures ************************************************

// 'hungrey', 128x64px
const unsigned char hungryFace [] PROGMEM = {
  0xff, 0xff, 0xff, 0xff, 0xff, 0xff, 0xff, 0xff, 0xff, 0xff, 0xff, 0xff, 0xff, 0xff, 0xff, 0xff, 
  0xff, 0xff, 0xff, 0xff, 0xff, 0xff, 0xff, 0xff, 0xff, 0xff, 0xff, 0xff, 0xff, 0xff, 0xff, 0xff, 
  0xff, 0xff, 0xff, 0xff, 0xff, 0xff, 0xff, 0xff, 0xff, 0xff, 0xff, 0xff, 0xff, 0xff, 0xff, 0xff, 
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  0xff, 0xff, 0xff, 0xff, 0xff, 0xff, 0xff, 0xff, 0xff, 0xff, 0xff, 0xff, 0xff, 0xff, 0xff, 0xff
};

// 'tt', 128x64px
const unsigned char thirstyFace [] PROGMEM = {
  0xff, 0xff, 0xff, 0xff, 0xff, 0xff, 0xff, 0xff, 0xff, 0xff, 0xff, 0xff, 0xff, 0xff, 0xff, 0xff, 
  0xff, 0xff, 0xff, 0xff, 0xff, 0xff, 0xff, 0xff, 0xff, 0xff, 0xff, 0xff, 0xff, 0xff, 0xff, 0xff, 
  0xff, 0xff, 0xff, 0xff, 0xff, 0xff, 0xff, 0xff, 0xff, 0xff, 0xff, 0xff, 0xff, 0xff, 0xff, 0xff, 
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  0xff, 0xff, 0xff, 0xff, 0xff, 0xff, 0xff, 0xff, 0xff, 0xff, 0xff, 0xff, 0xff, 0xff, 0xff, 0xff
};


// 'inLove', 128x64px
const unsigned char inLoveFace [] PROGMEM = {
  0xff, 0xff, 0xff, 0xff, 0xff, 0xff, 0xff, 0xff, 0xff, 0xff, 0xff, 0xff, 0xff, 0xff, 0xff, 0xff, 
  0xff, 0xff, 0xff, 0xff, 0xff, 0xff, 0xff, 0xff, 0xff, 0xff, 0xff, 0xff, 0xff, 0xff, 0xff, 0xff, 
  0xff, 0xff, 0xff, 0xff, 0xff, 0xff, 0xff, 0xff, 0xff, 0xff, 0xff, 0xff, 0xff, 0xff, 0xff, 0xff, 
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  0xff, 0xff, 0xff, 0xff, 0xff, 0xff, 0xff, 0xff, 0xff, 0xff, 0xff, 0xff, 0xff, 0xff, 0xff, 0xff
};

// 'bored', 128x64px
const unsigned char boredFace [] PROGMEM = {
  0xff, 0xff, 0xff, 0xff, 0xff, 0xff, 0xff, 0xff, 0xff, 0xff, 0xff, 0xff, 0xff, 0xff, 0xff, 0xff, 
  0xff, 0xff, 0xff, 0xff, 0xff, 0xff, 0xff, 0xff, 0xff, 0xff, 0xff, 0xff, 0xff, 0xff, 0xff, 0xff, 
  0xff, 0xff, 0xff, 0xff, 0xff, 0xff, 0xff, 0x80, 0x01, 0xff, 0xff, 0xff, 0xff, 0xff, 0xff, 0xff, 
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  0xff, 0xff, 0xff, 0xff, 0xff, 0xff, 0xff, 0xff, 0xff, 0xff, 0xff, 0xff, 0xff, 0xff, 0xff, 0xff
};

// 'dirty', 128x64px
const unsigned char dirtyFace [] PROGMEM = {
  0xff, 0xff, 0xff, 0xff, 0xff, 0xff, 0xff, 0xff, 0xff, 0xff, 0xff, 0xff, 0xff, 0xff, 0xff, 0xff, 
  0xff, 0xff, 0xff, 0xff, 0xff, 0xff, 0xff, 0xc0, 0x01, 0xff, 0xff, 0xff, 0xff, 0xff, 0xff, 0xff, 
  0xff, 0xff, 0xff, 0xff, 0xff, 0xff, 0xfc, 0x00, 0x00, 0x3f, 0xff, 0xff, 0xff, 0xff, 0xff, 0xff, 
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  0xff, 0xff, 0xff, 0xff, 0xff, 0xff, 0xff, 0xff, 0xff, 0xff, 0xff, 0xff, 0xff, 0xff, 0xff, 0xff
};

// 'happy', 128x64px
const unsigned char happyFace [] PROGMEM = {
  0xff, 0xff, 0xff, 0xff, 0xff, 0xff, 0xff, 0xff, 0xff, 0xff, 0xff, 0xff, 0xff, 0xff, 0xff, 0xff, 
  0xff, 0xff, 0xff, 0xff, 0xff, 0xff, 0xff, 0x00, 0x01, 0xff, 0xff, 0xff, 0xff, 0xff, 0xff, 0xff, 
  0xff, 0xff, 0xff, 0xff, 0xff, 0xff, 0xf8, 0x00, 0x00, 0x3f, 0xff, 0xff, 0xff, 0xff, 0xff, 0xff, 
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  0xff, 0xff, 0xff, 0xff, 0xff, 0xff, 0xff, 0xfc, 0x3f, 0xff, 0xff, 0xff, 0xff, 0xff, 0xff, 0xff
};

// 'oneNormalEye', 128x64px
const unsigned char normalEye [] PROGMEM = {
  0xff, 0xff, 0xff, 0xff, 0xff, 0xff, 0xff, 0xff, 0xff, 0xff, 0xff, 0xff, 0xff, 0xff, 0xff, 0xff, 
  0xff, 0xff, 0xff, 0xff, 0xff, 0xff, 0xff, 0xff, 0xc0, 0x3f, 0xff, 0xff, 0xff, 0xff, 0xff, 0xff, 
  0xff, 0xff, 0xff, 0xff, 0xff, 0xff, 0xff, 0xff, 0x00, 0x0f, 0xff, 0xff, 0xff, 0xff, 0xff, 0xff, 
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  0xff, 0xff, 0xff, 0xff, 0xff, 0xff, 0xff, 0xfc, 0x03, 0xff, 0xff, 0xff, 0xff, 0xff, 0xff, 0xff
};

// 'oneTiredEye', 128x64px
const unsigned char tiredEye [] PROGMEM = {
  0xff, 0xff, 0xff, 0xff, 0xff, 0xff, 0xff, 0xff, 0xff, 0xff, 0xff, 0xff, 0xff, 0xff, 0xff, 0xff, 
  0xff, 0xff, 0xff, 0xff, 0xff, 0xff, 0xff, 0xff, 0xff, 0xff, 0xff, 0xff, 0xff, 0xff, 0xff, 0xff, 
  0xff, 0xff, 0xff, 0xff, 0xff, 0xff, 0xff, 0xff, 0xff, 0xff, 0xff, 0xff, 0xff, 0xff, 0xff, 0xff, 
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  0xff, 0xff, 0xff, 0xff, 0xff, 0xff, 0xff, 0xff, 0xff, 0xff, 0xff, 0xff, 0xff, 0xff, 0xff, 0xff
};

// 'sad-emoji', 128x64px
const unsigned char sadFace [] PROGMEM = {
  0xff, 0xff, 0xff, 0xff, 0xff, 0xff, 0xff, 0x80, 0x01, 0xff, 0xff, 0xff, 0xff, 0xff, 0xff, 0xff, 
  0xff, 0xff, 0xff, 0xff, 0xff, 0xff, 0xfc, 0x00, 0x00, 0x3f, 0xff, 0xff, 0xff, 0xff, 0xff, 0xff, 
  0xff, 0xff, 0xff, 0xff, 0xff, 0xff, 0xe0, 0x07, 0xe0, 0x07, 0xff, 0xff, 0xff, 0xff, 0xff, 0xff, 
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  0xff, 0xff, 0xff, 0xff, 0xff, 0xff, 0xff, 0x80, 0x01, 0xff, 0xff, 0xff, 0xff, 0xff, 0xff, 0xff
};


// ********************************* MP3 ****************************************************************

// Define the required MP3 Player Commands:

// Select storage device to TF card
static int8_t select_SD_card[] = {0x7e, 0x03, 0X35, 0x01, 0xef}; // 7E 03 35 01 EF
// Play with index: /01/001xxx.mp3
static int8_t play_cat_sound[] = {0x7e, 0x04, 0x41, 0x00, 0x01, 0xef}; // 7E 04 41 00 01 EF
// Play with index: /01/002xxx.mp3
static int8_t play_dog_sound[] = {0x7e, 0x04, 0x41, 0x00, 0x02, 0xef}; // 7E 04 41 00 02 EF
// Play with index: /01/003xxx.mp3
static int8_t play_frog_sound[] = {0x7e, 0x04, 0x41, 0x00, 0x03, 0xef}; // 7E 04 41 00 01 EF
// Play with index: /01/004xxx.mp3
static int8_t play_elephant_sound[] = {0x7e, 0x04, 0x41, 0x00, 0x04, 0xef}; // 7E 04 41 00 02 EF
// Play with index: /01/005xxx.mp3
static int8_t play_hamster_sound[] = {0x7e, 0x04, 0x41, 0x00, 0x05, 0xef}; // 7E 04 41 00 01 EF
// Play with index: /01/006xxx.mp3
static int8_t play_lion_sound[] = {0x7e, 0x04, 0x41, 0x00, 0x06, 0xef}; // 7E 04 41 00 02 EF
// Play with index: /01/007xxx.mp3
static int8_t play_bird_sound[] = {0x7e, 0x04, 0x41, 0x00, 0x07, 0xef}; // 7E 04 41 00 01 EF
// Play with index: /01/008xxx.mp3
static int8_t play_inLove_song[] = {0x7e, 0x04, 0x41, 0x00, 0x08, 0xef}; // 7E 04 41 00 02 EF
// Play with index: /01/009xxx.mp3
static int8_t play_first_sentence[] = {0x7e, 0x04, 0x41, 0x00, 0x09, 0xef}; // 7E 04 41 00 02 EF
// Play the song.
static int8_t play[] = {0x7e, 0x02, 0x01, 0xef}; // 7E 02 01 EF
// Pause the song.
static int8_t pause[] = {0x7e, 0x02, 0x02, 0xef}; // 7E 02 02 EF

// ********************************* end of MP3 ********************************************************

#include <Servo.h>
#include <Wire.h>
#include <Adafruit_GFX.h>
#include <Adafruit_SSD1306.h>
#include <SoftwareSerial.h>

// Define the RX and TX pins to establish UART communication with the MP3 Player Module.
#define MP3_RX 19 // to TX
#define MP3_TX 18 // to RX

SoftwareSerial MP3(MP3_RX, MP3_TX);     // Define the Serial MP3 Player Module.

//OLED
#define OLED_RESET 4
Adafruit_SSD1306 display(128, 64, &Wire, OLED_RESET);

#define buttonPin 2 // the number of the pushbutton pin
#define servoPin 8
#define rPin 9
#define gPin 10
#define bPin 11
#define echoPin 12
#define trigPin 13

#define MAX_SEC 86400
String ADULT_LEVEL = "2";
long duration = 0, distance = 0;
int petted_flag = 0;
int sleep_flag = 0;
int pet_is_sleeping = 0;
int turn_on_ldr_flag = 0;
String petType = "Dog";
String level = "";
String current_mood = "normal";
String current_command = "$            ";
int sec = 0;
int lock = 1;
int logged_user = 0;
//int play_lock = 1;
//int sleep_lock = 1;
//int hungry_lock = 1;
//int thirsty_lock = 1;
//int dirty_lock = 1;
//int inLove_lock = 1;

//intializing the servo motor
Servo myservo;
int pos = 0;

// variables will change:
int buttonState = 0; // variable for reading the pushbutton status

//LDR and led button:
#define ldrPin A0
int ldrValue = 0;

void setup()
{
  display.begin(SSD1306_SWITCHCAPVCC, 0x3C);
  display.clearDisplay(); //for Clearing the display
  display.drawBitmap(0, 0, normalEye, 128, 64, WHITE);
  display.display();

  Wire.begin(8);                /* join i2c bus with address 8 */
  Wire.onReceive(receiveEvent); /* register receive event */
  Wire.onRequest(requestEvent); /* register request event */
  Serial.begin(9600);           /* start serial for debug */

  MP3.begin(9600);                               // Initiate the Serial MP3 Player Module.
  send_command_to_MP3_player(select_SD_card, 5); // Select the SD Card.

  pinMode(trigPin, OUTPUT);
  pinMode(echoPin, INPUT);

  pinMode(rPin, OUTPUT);
  pinMode(gPin, OUTPUT);
  pinMode(bPin, OUTPUT);

  myservo.attach(servoPin); // servo initialization
}

void loop()
{
  initDistanceSensor();
  //*************************    LDR sensor   ****************************
  /*  blue switch button is off
   *  red when theres light
   *  green when its dark
  */
  // read the state of the pushbutton value:
  buttonState = digitalRead(buttonPin);

  // check if the pushbutton is pressed. If it is, the buttonState is HIGH:
  if (buttonState == HIGH) {
    LDRFunction();
  }
  //************************* end of LDR sensor **************************
  else {
    lightBlue();
    if (distance < 3) {
      //light green
      lightMagenta();
      rotateServo();
    }
    else {
      myservo.write(0);
      //light blue
      lightBlue();
    }
    //**********************************************************************
  }

  //*************************************************************************

  if (sec == 20 && lock == 1) {
    current_command = "Play$        ";
    current_mood = "bored";
    petted_flag = 0;
    pet_is_sleeping = 0;
    turn_on_ldr_flag = 0;
    ldrValue = 10000;
    lock = 0;
  }
  if (sec == 40 && petted_flag != 1 && lock == 1) {
    // display sad face and move its ears:
    current_command = "Sad$         ";
    current_mood = "sad";
    turn_on_ldr_flag = 0;
    ldrValue = 10000;
    lock = 0;
  }
  if (sec > 20 && sec <= 39 && petted_flag != 1 && distance < 3 && lock == 1) {
    // display happy face and move its ears
    current_command = "Happy$       ";
    current_mood = "happy";
    petted_flag = 1;
    turn_on_ldr_flag = 0;
    ldrValue = 10000;
    lock = 0;
  }
  
  if (sec == 45 && lock == 1) {
    current_command = "Sleep$       ";
    current_mood = "sleepy";
    sleep_flag = 0;
    pet_is_sleeping = 0;
    turn_on_ldr_flag = 1;
    ldrValue = 10000;
    lock = 0;
  }
  if (sec == 65 && sleep_flag != 1 && lock == 1) {
    // display sad face
    current_command = "Sad$         ";
    current_mood = "sad";
    pet_is_sleeping = 0;
    turn_on_ldr_flag = 0;
    ldrValue = 10000;
    lock = 0;
  }
  if (sec > 45 && sec <= 64 && sleep_flag != 1 && ldrValue < 600 && lock == 1) {
    // display happy face and move its ears
    current_command = "Happy$       ";
    current_mood = "off";
    sleep_flag = 1;
    pet_is_sleeping = 1;
    turn_on_ldr_flag = 0;
    ldrValue = 10000;
    lock = 0;
  }
  
  if (sec == 70 && lock == 1) {
    // display black screen or sad face and move its ears
    current_command = "Hungry$      ";
    current_mood = "hungry";
    pet_is_sleeping = 0;
    turn_on_ldr_flag = 0;
    ldrValue = 10000;
    lock = 0;
  }
  
  if (sec == 85 && lock == 1) {
    // display black screen or sad face and move its ears
    current_command = "Thirsty$     ";
    current_mood = "thirsty";
    pet_is_sleeping = 0;
    turn_on_ldr_flag = 0;
    ldrValue = 10000;
    lock = 0;
  }

  if (sec == 100 && lock == 1) {
    // display sad face and move its ears
    current_command = "Dirty$       ";
    current_mood = "dirty";
    pet_is_sleeping = 0;
    turn_on_ldr_flag = 0;
    ldrValue = 10000;
    lock = 0;
  }

  if (sec == 105 && lock == 1) {
    // display sad face and move its ears
    current_command = "InLove$      ";
    current_mood = "inLove";
    pet_is_sleeping = 0;
    turn_on_ldr_flag = 0;
    ldrValue = 10000;
    lock = 0;
  }

  if(sec == 110 && level >= ADULT_LEVEL) {
    makeSound("Sentence1");
  }
  
  if (110 < sec && lock == 1) {
    current_command = "$            ";
    current_mood = "normal";
    turn_on_ldr_flag = 0;
    ldrValue = 10000;
    lock = 0;
  }

  //*******************************************************************************
  showCurrentReaction(current_mood);
  delay(1000);
  
  if (turn_on_ldr_flag == 1) {
    LDRFunction();
  }
  
  if(logged_user == 0) {
    duration = 0, distance = 0;
    ldrValue = 1000;
    petted_flag = 0;
    sleep_flag = 0;
    pet_is_sleeping = 0;
    turn_on_ldr_flag = 0;
    petType = "Dog";
    sec = 0;
    current_command = "$            ";
    current_mood = "normal";
    lock = 1;
  }
  if(logged_user == 1) {
    sec++;
  }
  if (sec == MAX_SEC) {
    current_command = "$            ";
    sec = 0;
  }
  Serial.println(sec);
  delay(1000);
}

// function that executes whenever data is received from master
void receiveEvent(int howMany) {
  String str = "";
  while (0 < Wire.available()) {
    char c = Wire.read(); /* receive byte as a character */
    Serial.print(c);      /* print the character */
    str += String(c);
    if(c == '#') {
      extractPetTypeAndLevel(str);    
    }
    if(c == '1') {
      logged_user = 1;
    }
    if(c == '0') {
      logged_user = 0;
    }
  }
  Serial.println(); /* to newline */
  //Serial.println("in receiveEvent: " + petType);
}

// function that executes whenever data is requested from master
void requestEvent() {
  if(current_command != "" && lock == 0) {
    Wire.write(current_command.c_str());
    lock = 1;
  }
}

//*********************** functions ************************************

void rotateServo() {
  for (pos = 0; pos <= 90; pos += 1) {
    myservo.write(pos);
    delay(15);
  }
  for (pos = 90; pos >= 0; pos -= 1) {
    myservo.write(pos);
    delay(15);
  }
}
void initDistanceSensor() {
  //************************* init distance sensor ****************************
  digitalWrite(trigPin, LOW);
  delayMicroseconds(2);
  // שליחת פולס מעורר
  digitalWrite(trigPin, HIGH);
  delayMicroseconds(10);
  // סיום פולס מעורר
  digitalWrite(trigPin, LOW);
  // המתנה והד מוחזר ומדידת זמן
  duration = pulseIn(echoPin, HIGH);
  //חישוב המרחק
  distance = (duration / 2) / 29.1;
  //************************* end of init distance sensor **********************
}
void LDRFunction() {
  ldrValue = analogRead(ldrPin);
  //Serial.println(ldrValue);
  if (ldrValue > 600)
  {
    lightRed();
  }
  else
  {
    lightGreen();
  }
}

void lightMagenta() {
  analogWrite(rPin, 255);
  analogWrite(gPin, 0);
  analogWrite(bPin, 255);
}

void lightBlue() {
  analogWrite(rPin, 0);
  analogWrite(gPin, 0);
  analogWrite(bPin, 255);
}

void lightRed() {
  analogWrite(rPin, 255);
  analogWrite(gPin, 0);
  analogWrite(bPin, 0);
}

void lightGreen() {
  analogWrite(rPin, 0);
  analogWrite(gPin, 255);
  analogWrite(bPin, 0);
}

void displayMood(String mood) {
  Serial.println("in displayMood, my mood: " + mood);
  display.clearDisplay();
  char *tmp = mood.c_str();
  if (strcmp(tmp, "normal") == 0)
    display.drawBitmap(0, 0, normalEye, 128, 64, WHITE); // display.drawBitmap(x position, y position, bitmap data, bitmap width, bitmap height, color)
  else if (strcmp(tmp, "happy") == 0)
    display.drawBitmap(0, 0, happyFace, 128, 64, WHITE); // display.drawBitmap(x position, y position, bitmap data, bitmap width, bitmap height, color)

  else if (strcmp(tmp, "sad") == 0)
    display.drawBitmap(0, 0, sadFace, 128, 64, WHITE); // display.drawBitmap(x position, y position, bitmap data, bitmap width, bitmap height, color)

  else if (strcmp(tmp, "bored") == 0)
    display.drawBitmap(0, 0, boredFace, 128, 64, WHITE); // display.drawBitmap(x position, y position, bitmap data, bitmap width, bitmap height, color)

  else if (strcmp(tmp, "sleepy") == 0)
    display.drawBitmap(0, 0, tiredEye, 128, 64, WHITE); // display.drawBitmap(x position, y position, bitmap data, bitmap width, bitmap height, color)

  else if (strcmp(tmp, "hungry") == 0)
    display.drawBitmap(0, 0, hungryFace, 128, 64, WHITE); // display.drawBitmap(x position, y position, bitmap data, bitmap width, bitmap height, color)

  else if (strcmp(tmp, "thirsty") == 0)
    display.drawBitmap(0, 0, thirstyFace, 128, 64, WHITE); // display.drawBitmap(x position, y position, bitmap data, bitmap width, bitmap height, color)

  else if (strcmp(tmp, "dirty") == 0)
    display.drawBitmap(0, 0, dirtyFace, 128, 64, WHITE); // display.drawBitmap(x position, y position, bitmap data, bitmap width, bitmap height, color)

  else if (strcmp(tmp, "inLove") == 0)
    display.drawBitmap(0, 0, inLoveFace, 128, 64, WHITE); // display.drawBitmap(x position, y position, bitmap data, bitmap width, bitmap height, color)

  display.display();
}

void send_command_to_MP3_player(int8_t command[], int len) {
  Serial.print("\nMP3 Command => ");
  for (int i = 0; i < len; i++) {
    MP3.write(command[i]);
    Serial.print(command[i], HEX);
  }
  Serial.println();
  delay(1000);
}

void makeSound(char* animal) {
  if (strcmp(animal, "Dog") == 0)
    send_command_to_MP3_player(play_dog_sound, 6);
  else if (strcmp(animal, "Cat") == 0)
    send_command_to_MP3_player(play_cat_sound, 6);
  else if (strcmp(animal, "Frog") == 0)
    send_command_to_MP3_player(play_frog_sound, 6);
  else if (strcmp(animal, "Elephant") == 0)
    send_command_to_MP3_player(play_elephant_sound, 6);
  else if (strcmp(animal, "Hamster") == 0)
    send_command_to_MP3_player(play_hamster_sound, 6);
  else if (strcmp(animal, "Lion") == 0)
    send_command_to_MP3_player(play_lion_sound, 6);
  else if (strcmp(animal, "Bird") == 0)
    send_command_to_MP3_player(play_bird_sound, 6);
  else if (strcmp(animal, "InLove") == 0) {
    send_command_to_MP3_player(play_inLove_song, 6);
    delay(7000);
  }
  else if(strcmp(animal, "Sentence1") == 0) {
    send_command_to_MP3_player(play_first_sentence, 6);
  }

  delay(10000);
}

void showCurrentReaction(String mood) {
  displayMood(mood);
  if (mood != "off" && mood != "sad" && mood != "normal"){
    if(mood == "inLove") {
      makeSound("InLove");
    }
    else {
      makeSound(petType.c_str());
    }
    rotateServo();
  }
  if (mood != "normal" && mood != "off")
    delay(10000);
  if(mood != "off") {
    current_mood = "normal";
  }
}

//****************************************************************************
void extractPetTypeAndLevel(String str) {
  //if(str == "@#") return;
  petType = "";
  level = "";
  str.replace("#","");
  str.replace("@","");

  int counter = 1;
  for(int i = 0; i < str.length(); i++) {
    if(String(str[i]) != ",") {
      switch(counter) {
        case 1: petType += str[i]; continue;
        case 2: level += str[i]; continue;
      }
    }
    else {
      counter++;
    }
  }

  Serial.println();
  Serial.println("in extractPetTypeAndLevel: " + petType);
  Serial.println("in extractPetTypeAndLevel: " + level);
}
